## layers/meta-robomower/conf/layer.conf
```bitbake
# We have a conf and classes directory, add to BBPATH
BBPATH =. "${LAYERDIR}:"

# We have recipes-* directories, add to BBFILES
BBFILES += "${LAYERDIR}/recipes-*/*/*.bb \
            ${LAYERDIR}/recipes-*/*/*.bbappend"

BBFILE_COLLECTIONS += "robomower"
BBFILE_PATTERN_robomower = "^${LAYERDIR}/"
BBFILE_PRIORITY_robomower = "6"

LAYERVERSION_robomower = "1"
LAYERSERIES_COMPAT_robomower = "kirkstone"
```
